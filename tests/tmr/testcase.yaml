## tests/tmr/testcase.yaml
```yaml
tests:
  app.tmr:
    tags:
      - tmr
    platform_allow:
      - qemu_cortex_m3
      - native_sim
      - native_sim/native/64
    integration_platforms:
      - qemu_cortex_m3
```
