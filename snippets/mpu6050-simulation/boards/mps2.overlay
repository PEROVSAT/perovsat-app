/ {
	aliases {
		imu = &mpu6050;
	};

	i2c_emul: i2c@100 {
		compatible = "zephyr,i2c-emul-controller";
		reg = <0x100 4>;
		#address-cells = <1>;
		#size-cells = <0>;
		clock-frequency = <100000>;
		status = "okay";
	};
};

&i2c_emul {
	mpu6050: mpu6050@68 {
		compatible = "zephyr,mpu6050";
		reg = <0x68>;
		status = "okay";
	};
};
