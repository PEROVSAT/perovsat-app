## CMakeLists.txt
```
cmake_minimum_required(VERSION 3.20.0)

set(SNIPPET_ROOT ${CMAKE_CURRENT_SOURCE_DIR})

# Pico boards: default west flash/ninja flash to UF2 (BOOTSEL drag-and-drop).
if(BOARD MATCHES "^rpi_pico")
	set(BOARD_FLASH_RUNNER uf2)
endif()

find_package(Zephyr REQUIRED HINTS $ENV{ZEPHYR_BASE})
project(cubesat_app)

# Enable C++17
set(CMAKE_CXX_STANDARD 17)

target_include_directories(app PRIVATE
  ${CMAKE_CURRENT_SOURCE_DIR}/include
)

target_sources(app PRIVATE
    src/main.cpp
    src/syshealth/system_health.cpp
    src/syshealth/watchdog.cpp
    src/payload/hw.cpp
    src/payload/payload.cpp
    src/payload/PayloadReading.cpp
    src/dfa/dfa.cpp
    src/communications/communications.cpp
    src/commands/commands.cpp
)
```

## Kconfig
```
mainmenu "PerovSat Application"

source "Kconfig.zephyr"
```

## west.yml
```
manifest:
  remotes:
    - name: zephyrproject-rtos
      url-base: https://github.com/zephyrproject-rtos
    - name: origin
      url-base: https://github.com/PEROVSAT

  projects:
    - name: zephyr
      remote: zephyrproject-rtos
      revision: v4.4.0
      import:
        name-allowlist:
          - cmsis_6
          - cmsis
          - hal_stm32
          - hal_rpi_pico
          - littlefs

    - name: mpu6050-driver
      remote: origin
      revision: main

    - name: amu-driver
      remote: origin
      revision: main

  self:
    path: perovsat-app
    west-commands: dbuild/west-commands.yml
```

## prj.conf
```kconfig
CONFIG_CPP=y
CONFIG_STD_CPP17=y

CONFIG_LOG=y
CONFIG_LOG_DEFAULT_LEVEL=3
CONFIG_SERIAL=y
CONFIG_UART_CONSOLE=y

CONFIG_SENSOR=y
CONFIG_FPU=y
CONFIG_CBPRINTF_FP_SUPPORT=y

CONFIG_LOG_BUFFER_SIZE=8192

# Main thread does things like LittleFS, so even if it ends once booted, it still needs some allocation
CONFIG_MAIN_STACK_SIZE=8192

CONFIG_HW_STACK_PROTECTION=y
CONFIG_THREAD_STACK_INFO=y

# Optional: CONFIG_I2C_SHELL=y in a snippet when bus debugging is needed.
```

## dbuild_devices.conf
```kconfig
# dbuild_devices.conf — per-device mode selection
#
# Set each device to one of: public-mock, library-mock, simulation, hardware.
# This file is committed. Change it to match your current target setup.
# Run `west dbuild -b <board>` to build; run `west dbuild -b <board> --dry-run`
# to see the resolved snippet list without building.
#
# Valid modes: public-mock, library-mock, simulation, hardware

IMU=public-mock
MODEM=public-mock
AMU=public-mock
```

## dts/bindings/perovsat,mpu6050-mock.yaml
```yaml
description: Mock MPU6050 IMU for testing
compatible: "perovsat,mpu6050-mock"
include: base.yaml
```

## src/main.cpp
```c
#include <zephyr/kernel.h>

int main(void)
{
	// Zephyr requires this to be here, but everything we do is in threads
	// If you're just looking for the main code, system_health.cpp is the best place to start
	return 0;
}
```

## include/communications.hpp
```c
#pragma once

namespace comms
{

/*
 * Wake signal, DFA -> Communications.
 *
 * DFA gives this after committing a processed batch to its outbox so the Comms
 * thread can attempt a downlink promptly instead of polling the filesystem on a
 * timer ("Wake Communications" in the DFA flowchart). Idempotent: repeated wakes
 * before Comms services one collapse into a single pending signal. Defined in
 * communications.cpp.
 */
void wake(void);

} // namespace comms
```

## include/dfa.hpp
```c
#pragma once

#include "global_flags.hpp"

#include <cstddef>
#include <cstdint>

/*
 * Data Filtering & Analysis worker.
 *
 * The DFA thread owns no devices ("Resource Ownership: None"): its inputs are
 * the raw payload records on LittleFS plus the op_status Global Flag, and its
 * output is a processed batch written back to LittleFS for Communications to
 * downlink. dfa.cpp is a thin orchestrator that walks the PDR flowchart; every
 * task with real work lives here so the run loop stays readable.
 *
 * One instance is constructed on the DFA thread's stack and lives for the life
 * of the thread; it is not shared, so its members need no locking.
 */
class DfaProcessor
{
      public:
	/* Restore persistent state (cumulative sun exposure) from LittleFS. */
	int init();

	/*
	 * Run one analysis pass for the given operating mode: fetch new payload
	 * data, apply the mode-appropriate transform, fold in cumulative sun
	 * exposure, and save the result to the outbox. Returns OR-accumulated
	 * dfa_err bits (0 on success, or when there was simply nothing to do).
	 */
	uint32_t process(sys::OpStatus mode);

	/* Delete raw payload data already folded into the outbox. */
	uint32_t reap_old();

	/* Whether the most recent process() durably committed a new batch to the
	 * outbox (i.e. there is something for Communications to downlink). */
	bool produced_output() const
	{
		return produced_;
	}

      private:
	/* Shared pipeline stages (both NOMINAL and HIGH paths). */
	int fetch_new_payload();        /* -> record count fetched, or <0 on error */
	void accumulate_sun_exposure(); /* Calculate Cumulative Sun Exposure per face */
	int save_new_data();            /* -> 0 on success */

	/* NOMINAL-mode transform. */
	void basic_filter(); /* Basic Filtering (Method TBD) */

	/* HIGH-mode transforms. */
	void iv_curve_fit(); /* (Tentative) IV Curve Fit */
	void compress();     /* (Tentative) Data Compression */

	/*
	 * A CubeSat presents six external faces; sun exposure accumulates across
	 * the whole mission, so it is checkpointed to LittleFS (see init()) and a
	 * reset must not silently zero it.
	 */
	static constexpr size_t FaceCount = 6;
	float sun_exposure_[FaceCount] = {};

	/*
	 * Raw records that have been durably committed to the outbox and are now
	 * safe to delete. Set only AFTER a successful save so a failed save (or a
	 * crash before save) never causes reap_old() to drop un-saved raw data.
	 */
	int reapable_records_ = 0;

	/* Set by process(): did the last pass put a new batch in the outbox? */
	bool produced_ = false;
};
```

## include/global_flags.hpp
```c
#pragma once

#include <zephyr/kernel.h>

#include <cstdint>

namespace sys
{

/*
 * System operating mode -- the "op_status" Global Flag the PDR flowcharts branch
 * on. Threads read it each epoch to decide how much work to attempt. Ordered by
 * how much resource/energy budget it implies:
 *
 *   SafeLow  - power/health constrained: do the minimum, preserve the vehicle.
 *   Nominal  - normal operations: run the baseline processing path.
 *   High     - surplus resources: run the heavier, higher-value analysis path.
 */
enum class OpStatus : uint32_t {
	/*
	 * Collapses the DFA flowchart's two red outcomes -- "SAFE" and "LOW" --
	 * into one value: both mean "do no analysis this epoch, preserve the
	 * vehicle", so DFA treats them identically. Split into separate Safe and
	 * Low values if the two ever need distinct behavior.
	 */
	SafeLow = 0,
	Nominal,
	High,
};

/*
 * Read/publish the current operating mode.
 *
 * Backed by a single atomic word (see global_flags.cpp), so any thread may read
 * it lock-free and a producer (System Health / FDIR / Commands) may update it
 * without coordinating with readers. This is the concrete "Global Flags" store
 * the DFA flowchart reads from.
 */
OpStatus op_status(void);
void set_op_status(OpStatus status);

} // namespace sys
```

## include/health_fdir.hpp
```c
#pragma once

#include "watchdog.hpp"

#include <cstdint>

/*
 * Fault Detection, Isolation and Recovery (FDIR) interface.
 *
 * ISupervised is a classic C++ interface: every concrete instance carries a
 * RAM-resident vptr, and each on_fault() call dispatches through the vtable.
 * In a radiation environment that vptr is an SEU-soft spot -- a single upset
 * flipping a bit in the vptr can redirect a virtual call to garbage. The
 * harder flight variant replaces the vtable with a const function-pointer
 * table living in .rodata/flash (immune to SEU in RAM), selected by a plain
 * index rather than a corruptible pointer. Left as future work.
 */

namespace health
{

/* What the FDIR layer decides to do about a degradation, in rising severity. */
enum class RecoveryAction : uint8_t {
	LogOnly,
	RestartThread,
	EnterSafeMode,
	ForceReset,
};

/*
 * One supervised subsystem. Implemented by a file-scope instance per monitored
 * thread; the watchdog holds a pointer to it and calls on_fault() on the first
 * poll that observes a degradation transition.
 */
class ISupervised
{
      public:
	virtual const char *name() const = 0;

	/* Decide the recovery action for a freshly-degraded subsystem. */
	virtual RecoveryAction on_fault(HealthStatus new_status, uint32_t errors) = 0;

      protected:
	/* Non-virtual: instances are never owned/deleted through this interface. */
	~ISupervised() = default;
};

/* The single recovery switch, shared by every supervised subsystem. */
void dispatch_recovery(MonitoredThread id, RecoveryAction action);

/*
 * File-scope supervised instances (concrete objects defined in health_fdir.cpp
 * with internal linkage; exposed here by reference for the arm() wire-up).
 */
extern ISupervised &payload_supervised;
extern ISupervised &dfa_supervised;
extern ISupervised &comms_supervised;
extern ISupervised &commands_supervised;

} // namespace health
```

## include/payload.hpp
```c
#pragma once

#include <cstdint>

namespace payload
{

/*
 * Error bits the Payload thread can OR into its heartbeat.
 *
 * Critical bits force the thread to Dead status; non-critical bits leave it
 * Partial. Keep these stable: their numeric values travel in heartbeats and
 * are interpreted by health::Watchdog.
 */
constexpr uint32_t ErrAmuTimeout = (1u << 0);    /* one AMU stopped responding (partial loss) */
constexpr uint32_t ErrImuBadData = (1u << 1);    /* IMU returned implausible values */
constexpr uint32_t ErrLittlefsWrite = (1u << 2); /* couldn't persist sample to flash (critical) */

constexpr uint32_t CriticalErrors = ErrLittlefsWrite;

} // namespace payload
```

## include/system_health.hpp
```c
#pragma once

#include <zephyr/sys/atomic.h>

extern atomic_t boot_count;
extern atomic_t op_status;
/*
This should be atomic because our OBC is multicore, and we'll want to use them both.
If a reader core tries to access it at the same time a writer core (system health) is
updating it, then that results in undefined behavior.

At the same time, we also want to have TMR on this, as its possibly the MOST critical variable
*/
```

## include/threads.hpp
```c
#pragma once

#include <zephyr/kernel.h>

// 1. Centralized Configuration
namespace ThreadConfig
{
constexpr size_t DefaultStackSize = 8192;
constexpr size_t PayloadStackSize = 16384;

// Priority levels (lower number = higher priority in Zephyr)
constexpr int SysHealthPriority = 5;
constexpr int PayloadPriority = 6;
constexpr int DfaPriority = 7;
constexpr int CommsPriority = 8;
constexpr int CommandsPriority = 9;

// Per-thread loop cadence. Single source of truth: the thread sleeps this long
// between passes AND System Health sizes the thread's watchdog epoch from it, so
// the two can never drift apart. DFA's is the short end of the PDR's 1-5 min
// budget, keeping the raw-payload backlog on the 128 KiB storage partition bounded.
constexpr int DfaEpochMs = 60000;
} // namespace ThreadConfig

// 2. Entry Function Declarations
extern void payload_entry(void *, void *, void *);
extern void dfa_entry(void *, void *, void *);
extern void comms_entry(void *, void *, void *);
extern void commands_entry(void *, void *, void *);

// 3. Thread ID Declarations (k_tid_t)
// This allows system_health.cpp to start threads defined in other files.
extern const k_tid_t payload_thread_id;
extern const k_tid_t dfa_thread_id;
extern const k_tid_t comms_thread_id;
extern const k_tid_t commands_thread_id;
```

## include/tmr.hpp
```c
#pragma once

/**
 * @file tmr.hpp
 * @brief Voting triple modular redundancy for primitive values.
 *
 * `Tmr<T>` keeps three replicas of a value. Writes update every replica.
 * `read()` majority-votes and repairs a dissenting replica when two copies
 * agree. Mutations go through the usual compound operators (`+=`, `++`, …),
 * which vote, apply the operation, then write the result back to all three.
 *
 * There is no conversion to `T`: callers must use `read()` to observe the
 * voted value. The type is limited to arithmetic and enumeration types so
 * those operators are well-defined without mutator lambdas.
 */

namespace tmr_detail
{

template <typename T> struct is_allowed {
	static constexpr bool value = __is_enum(T);
};

#define TMR_ALLOW(TYPE)                                                                            \
	template <> struct is_allowed<TYPE> {                                                      \
		static constexpr bool value = true;                                                \
	}

TMR_ALLOW(bool);
TMR_ALLOW(char);
TMR_ALLOW(signed char);
TMR_ALLOW(unsigned char);
TMR_ALLOW(short);
TMR_ALLOW(unsigned short);
TMR_ALLOW(int);
TMR_ALLOW(unsigned int);
TMR_ALLOW(long);
TMR_ALLOW(unsigned long);
TMR_ALLOW(long long);
TMR_ALLOW(unsigned long long);
TMR_ALLOW(float);
TMR_ALLOW(double);
TMR_ALLOW(long double);
TMR_ALLOW(wchar_t);
TMR_ALLOW(char16_t);
TMR_ALLOW(char32_t);

#undef TMR_ALLOW

} // namespace tmr_detail

template <typename T> class Tmr
{
	static_assert(tmr_detail::is_allowed<T>::value,
		      "Tmr<> supports arithmetic and enum types only");

      public:
	Tmr();
	Tmr(T value);

	Tmr(const Tmr &) = default;
	Tmr(Tmr &&) = default;
	Tmr &operator=(const Tmr &) = default;
	Tmr &operator=(Tmr &&) = default;
	~Tmr() = default;

	Tmr &operator=(T value);

	operator T() const = delete;

	T read() const;

#ifdef CONFIG_ZTEST
	/* Inject or inspect a single replica. Flight builds do not compile these. */
	void set_replica(unsigned index, T value);
	T get_replica(unsigned index) const;
#endif

	Tmr &operator+=(T rhs);
	Tmr &operator-=(T rhs);
	Tmr &operator*=(T rhs);
	Tmr &operator/=(T rhs);
	Tmr &operator%=(T rhs);
	Tmr &operator&=(T rhs);
	Tmr &operator|=(T rhs);
	Tmr &operator^=(T rhs);
	Tmr &operator<<=(T rhs);
	Tmr &operator>>=(T rhs);

	Tmr &operator++();
	T operator++(int);
	Tmr &operator--();
	T operator--(int);

      private:
	void store(T value);

	/* mutable: read() is logically const but may scrub a dissenting replica. */
	mutable volatile T a_;
	mutable volatile T b_;
	mutable volatile T c_;
};

template <typename T> Tmr<T>::Tmr() : Tmr(T{})
{
}

template <typename T> Tmr<T>::Tmr(T value) : a_(value), b_(value), c_(value)
{
}

template <typename T> Tmr<T> &Tmr<T>::operator=(T value)
{
	store(value);
	return *this;
}

template <typename T> T Tmr<T>::read() const
{
	const T a = a_;
	const T b = b_;
	const T c = c_;

	// TODO: Report SEUs to system health (secondary mission: report radiation problems on cheap
	// hardware)

	if (a == b) {
		if (a != c) {
			c_ = a;
		}
		return a;
	}
	if (a == c) {
		b_ = a;
		return a;
	}
	if (b == c) {
		a_ = b;
		return b;
	}

	// TODO: Handle MBU
	return a;
}

template <typename T> void Tmr<T>::store(T value)
{
	a_ = value;
	b_ = value;
	c_ = value;
}

#ifdef CONFIG_ZTEST
// These will only be included when doing tests. We obviously don't want to be able to change just
// one value in flight
template <typename T> void Tmr<T>::set_replica(unsigned index, T value)
{
	switch (index) {
	case 0:
		a_ = value;
		break;
	case 1:
		b_ = value;
		break;
	case 2:
		c_ = value;
		break;
	default:
		break;
	}
}

template <typename T> T Tmr<T>::get_replica(unsigned index) const
{
	switch (index) {
	case 0:
		return a_;
	case 1:
		return b_;
	case 2:
		return c_;
	default:
		return T{};
	}
}
#endif

/*
 * Individual Operators
 */

template <typename T> Tmr<T> &Tmr<T>::operator+=(T rhs)
{
	T value = read();
	value += rhs;
	store(value);
	return *this;
}

template <typename T> Tmr<T> &Tmr<T>::operator-=(T rhs)
{
	T value = read();
	value -= rhs;
	store(value);
	return *this;
}

template <typename T> Tmr<T> &Tmr<T>::operator*=(T rhs)
{
	T value = read();
	value *= rhs;
	store(value);
	return *this;
}

template <typename T> Tmr<T> &Tmr<T>::operator/=(T rhs)
{
	T value = read();
	value /= rhs;
	store(value);
	return *this;
}

template <typename T> Tmr<T> &Tmr<T>::operator%=(T rhs)
{
	T value = read();
	value %= rhs;
	store(value);
	return *this;
}

template <typename T> Tmr<T> &Tmr<T>::operator&=(T rhs)
{
	T value = read();
	value &= rhs;
	store(value);
	return *this;
}

template <typename T> Tmr<T> &Tmr<T>::operator|=(T rhs)
{
	T value = read();
	value |= rhs;
	store(value);
	return *this;
}

template <typename T> Tmr<T> &Tmr<T>::operator^=(T rhs)
{
	T value = read();
	value ^= rhs;
	store(value);
	return *this;
}

template <typename T> Tmr<T> &Tmr<T>::operator<<=(T rhs)
{
	T value = read();
	value <<= rhs;
	store(value);
	return *this;
}

template <typename T> Tmr<T> &Tmr<T>::operator>>=(T rhs)
{
	T value = read();
	value >>= rhs;
	store(value);
	return *this;
}

template <typename T> Tmr<T> &Tmr<T>::operator++()
{
	T value = read();
	++value;
	store(value);
	return *this;
}

template <typename T> T Tmr<T>::operator++(int)
{
	T value = read();
	T previous = value;
	++value;
	store(value);
	return previous;
}

template <typename T> Tmr<T> &Tmr<T>::operator--()
{
	T value = read();
	--value;
	store(value);
	return *this;
}

template <typename T> T Tmr<T>::operator--(int)
{
	T value = read();
	T previous = value;
	--value;
	store(value);
	return previous;
}
```

## include/watchdog.hpp
```c
#pragma once

#include <zephyr/kernel.h>

#include <cstddef>
#include <cstdint>

namespace health
{

/*
 * Compile-time roster of every monitored application thread.
 *
 * The enum value doubles as the thread's index into the watchdog's slot array
 * and as the id carried in each heartbeat. Fixing the roster at compile time is
 * what lets the watchdog avoid all dynamic allocation, and it means the
 * monitored set can never drift away from the set that was actually started.
 */
enum class MonitoredThread : uint8_t {
	Payload = 0,
	Dfa,
	Comms,
	Commands,
	Count,
};

constexpr size_t MonitoredThreadCount = static_cast<size_t>(MonitoredThread::Count);

/*
 * Coarse health of a monitored thread or device. Ordered by severity so a
 * plain numeric comparison detects a degradation (a larger value is worse):
 * Nominal < Partial < Dead.
 */
enum class HealthStatus : uint8_t {
	Nominal,
	Partial,
	Dead,
};

/*
 * Per-subsystem error-bit catalogs.
 *
 * Each namespace is a private numbering space, so the same physical bit can
 * mean entirely different things depending on which thread OR-ed it into its
 * heartbeat. The watchdog never interprets these bits generically; only the
 * device_map below (and the owning worker) knows what a given bit means.
 */
namespace payload_err
{
enum : uint32_t {
	ImuNotReady = 1u << 0,
	ImuReadFail = 1u << 1,
	AmuSweepFail0 = 1u << 2,
	AmuSweepFail1 = 1u << 3,
};
} // namespace payload_err

namespace dfa_err
{
enum : uint32_t {
	FetchFail = 1u << 0,     /* could not read raw payload data from LittleFS */
	TransformFail = 1u << 1, /* filtering / fit / compression stage failed */
	SaveFail = 1u << 2,      /* could not write the processed batch to the outbox */
	ReapFail = 1u << 3,      /* could not delete raw data already folded in */
};
} // namespace dfa_err

namespace comms_err
{
enum : uint32_t {
	ModemFault = 1u << 0,
};
} // namespace comms_err

/*
 * Monitored physical devices. Unlike threads a device has no heartbeat of its
 * own; its health is derived from its owning thread's liveness plus the error
 * bits that thread reports for it (see device_map in watchdog.cpp).
 */
enum class MonitoredDevice : uint8_t {
	Imu = 0,
	AmuZps0,
	AmuZps1,
	Modem,
	Count,
};

/* Forward declaration: the watchdog only stores ISupervised by pointer. */
class ISupervised;

/* Number of buffered check-ins. Sized for the busiest burst, not the thread count. */
constexpr size_t HeartbeatQueueDepth = 16;

/* One check-in. Trivially copyable so it can travel through a k_msgq by value. */
struct Heartbeat {
	uint8_t thread_id;  /* index into the monitored-thread roster */
	uint32_t uptime_ms; /* k_uptime_get_32() at send time */
	uint32_t errors;    /* error bits OR-accumulated over the thread's loop iteration */
};

/*
 * Per-thread heartbeat watchdog, owned and polled by System Health.
 *
 * Every byte of state is statically sized: the slot array below and the backing
 * message queue (see watchdog.cpp) are both allocated at build time. There is
 * no heap use anywhere in this class.
 */
class Watchdog
{
      public:
	/*
	 * Register a thread on System Health's start path. Starting a thread is
	 * its registration, so the monitored set always matches the started set.
	 *
	 *   epoch_ms          expected maximum interval between check-ins
	 *   max_missed_cycles missed windows tolerated before a fault is declared
	 *   startup_grace_ms  extra time allowed for the very first check-in
	 *   handler           recovery interface invoked on a degradation
	 *                     transition (may be null -> LogOnly)
	 */
	void arm(MonitoredThread id, uint32_t epoch_ms, uint32_t max_missed_cycles,
		 uint32_t startup_grace_ms, ISupervised *handler);

	/*
	 * Called by a worker at the top/bottom of its loop. Never blocks the
	 * caller. `errors` is that iteration's OR-accumulated error bitmask.
	 */
	static void check_in(MonitoredThread id, uint32_t errors);

	/* Called by System Health every tick: drain the queue, then evaluate. */
	void poll();

	/* Cached health of a monitored thread. Inactive/out-of-range -> Dead. */
	HealthStatus status(MonitoredThread id) const;

	/* Health of a device: derived from its owner thread and reported bits. */
	HealthStatus status(MonitoredDevice dev) const;

	/* Thin back-compat wrapper: a thread is "faulted" iff it is Dead. */
	bool is_faulted(MonitoredThread id) const;

      private:
	struct Slot {
		uint32_t epoch_ms = 0;
		uint32_t max_missed_cycles = 0;
		uint32_t startup_grace_ms = 0;
		uint32_t last_seen_ms = 0;
		uint32_t latest_errors = 0; /* most recent heartbeat's error bits (latest-wins) */
		bool active = false;        /* armed and being monitored */
		bool seen_first = false;    /* has checked in at least once */
		HealthStatus status = HealthStatus::Dead; /* cached, written once per poll */
	};

	/* Static resolution of a device to its owning thread and error mask. */
	struct DeviceMap {
		MonitoredThread owner;
		uint32_t dev_mask;
	};
	static DeviceMap device_map(MonitoredDevice dev);

	void record(const Heartbeat &hb);
	void evaluate(uint32_t now);

	Slot slots_[MonitoredThreadCount];
	ISupervised *handlers_[MonitoredThreadCount] = {};
};

/* The single instance, defined in watchdog.cpp and owned by System Health. */
extern Watchdog watchdog;

} // namespace health
```

## src/commands.cpp
```c
#include "threads.hpp"
#include <zephyr/logging/log.h>

LOG_MODULE_REGISTER(commands, LOG_LEVEL_DBG);

K_THREAD_DEFINE(commands_thread_id, ThreadConfig::DefaultStackSize, commands_entry,
                NULL, NULL, NULL, ThreadConfig::CommandsPriority, 0, -1);

void commands_entry(void *p1, void *p2, void *p3) {
    LOG_INF("Commands Thread Started");

    while (1) {
        LOG_INF("Commands: polling for uplink...");
        k_sleep(K_MSEC(4000));
    }
}
```

## src/communications.cpp
```c
#include "threads.hpp"
#include "communications.hpp"

#include <zephyr/kernel.h>
#include <zephyr/logging/log.h>

#include "eyestar_s4.h"

LOG_MODULE_REGISTER(comms, LOG_LEVEL_DBG);

/*
 * Binary latch (max count 1) rather than a counter: Comms only needs to know
 * that "there is new work", not how many times DFA nudged it. Defined at file
 * scope (Zephyr kernel objects are section-placed and belong at file scope, not
 * inside a namespace). Whether Comms blocks on this in place of its fixed sleep
 * is a Communications-thread change left for that increment; DFA already gives
 * it here via comms::wake().
 */
K_SEM_DEFINE(comms_wake_sem, 0, 1);

namespace comms
{

void wake(void)
{
	k_sem_give(&comms_wake_sem);
}

} // namespace comms

K_THREAD_DEFINE(comms_thread_id, ThreadConfig::DefaultStackSize, comms_entry, NULL, NULL, NULL,
		ThreadConfig::CommsPriority, 0, -1);

void comms_entry(void *p1, void *p2, void *p3)
{
	LOG_INF("Communications Thread Started");

	const struct device *modem = DEVICE_DT_GET(DT_ALIAS(modem));
	uint8_t rx_buf[205];
	eyestar_transfer_result_t res;

	int ret = eyestar_transfer(modem, NULL, 0, rx_buf, &res);
	LOG_INF("eyestar_transfer returned %d, tx_status=%d", ret, res.tx_status);

	while (1) {
		k_sleep(K_MSEC(5000));
	}
}
```

## src/dfa.cpp
```c
#include "threads.hpp"
#include "dfa.hpp"
#include "global_flags.hpp"
#include "communications.hpp"
#include "watchdog.hpp"

#include <zephyr/logging/log.h>

// NOTE: It's important for delivery guarantees that dfa output filename is identical to the payload
// input's

LOG_MODULE_REGISTER(dfa, LOG_LEVEL_DBG);

K_THREAD_DEFINE(dfa_thread_id, ThreadConfig::DefaultStackSize, dfa_entry, NULL, NULL, NULL,
		ThreadConfig::DfaPriority, 0, -1);

/*
 * DFA thread entry -- a thin orchestrator. This function is a direct transcription
 * of the "Data Filtering & Analysis" flowchart: it sequences the tasks and owns
 * the control flow (heartbeat, op_status branch, wake, yield); DfaProcessor owns
 * the work.
 */
void dfa_entry(void *p1, void *p2, void *p3)
{
	LOG_INF("DFA Thread Started");

	DfaProcessor proc;
	if (proc.init() != 0) {
		LOG_ERR("DFA init failed; thread exiting");
		return; /* watchdog will observe the silence and act */
	}

	/*
	 * Errors from a pass are reported on the NEXT pass's heartbeat, which the
	 * flowchart places first in the loop ("Send SysHealth Heartbeat"). Seeded
	 * to 0 so the first heartbeat after startup reports a clean slate.
	 */
	uint32_t err = 0;

	while (1) {
		/* 1. Send SysHealth Heartbeat (carries the prior pass's errors). */
		health::Watchdog::check_in(health::MonitoredThread::Dfa, err);
		err = 0;

		/* 2. Read op_status from the Global Flags and branch. */
		const sys::OpStatus mode = sys::op_status();

		switch (mode) {
		case sys::OpStatus::SafeLow:
			/* SAFE/LOW: preserve resources, do no analysis this epoch. */
			LOG_DBG("op_status SAFE/LOW: yielding without work");
			break;

		case sys::OpStatus::Nominal:
		case sys::OpStatus::High:
			/* 3. Fetch -> transform -> sun exposure -> save to LittleFS. */
			err |= proc.process(mode);
			/* 4. Delete old (raw) data from LittleFS. */
			err |= proc.reap_old();
			/* 5. Wake Communications only if a new batch reached the outbox;
			 * nudging Comms with nothing to send just wastes its wakeups. */
			if (proc.produced_output()) {
				comms::wake();
			}
			break;
		}

		/* 6. Yield CPU for the epoch. */
		k_sleep(K_MSEC(ThreadConfig::DfaEpochMs));
	}
}
```
